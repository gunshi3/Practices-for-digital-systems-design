/**********************
文件名称：alarm.c
作者：
说明：进行振动声光报警器测试的例程,振动发生时，将点亮LED和蜂鸣器将发声
修改记录：
***********************/

/**********************
基于STC15F2K60S2系列单片机C语言编程实现
使用如下头文件，不用另外再包含"REG51.H"
***********************/
#include <STC15F2K60S2.h>			  //包含头文件

#define uint unsigned int			  //宏定义
#define uchar unsigned char

/****************************
引脚定义
****************************/
sbit vibrate=P2^4;		    //振动传感器
sbit led_sel=P2^3;			//数码管与LED灯切换引脚
sbit beep = P3^4;			//蜂鸣器引脚
sbit key1 = P3^2;			//key1开关引脚

/*****************************
变量定义
*****************************/
uchar flag;				  //振动标志位
uchar code table[]={0x00,0x01,0x03,0x07,0x0f,0x1f,0x3f,0x7f,0xff};		//流水灯报警闪烁数组
/**********************
函数名称：void delay()
功能描述：延时
入口参数：xms：输入延时时间
出口参数：无
备注：

***********************/
void delay(unsigned int xms)
{
	uint i,j;						   
	 for(i=xms;i>0;i--)
	 	for(j=100;j>0;j--);
}

/**********************
函数名称：void init_sys()
功能描述：系统初始化，功能是配置IO口
入口参数：无
出口参数：无
备注：

***********************/
void init_sys()			  
{
	P0M0=0xff;								//设置推挽模式
	P0M1=0x00;
	P2M0=0x08;
	P2M1=0x00;
	P3M0=0x10;
	P3M1=0x00;

	TMOD=0x00;							    //定时器0，定时方式0，16位自动重装
	TH0=0xff;								//赋初值
	TL0=0x03;
	EA=1;									//开总中断
	ET0=1;									//开定时器0中断
	TR0=1;									//开启定时器0

	led_sel=1;								//选通LED灯
	P0=0x00;								//关闭P0口
	beep=0;									//beep端口置0，起保护蜂鸣器作用
	flag=0;									//振动标志位
	vibrate=1;								//振动传感器引脚置1

}
void main()
{
	uchar i;					//定义局部变量i,用作流水灯闪烁
	init_sys();					//系统初始化
	while(1)
	{
		if(vibrate==0)		   //若检测到低电平说明振动发生
		{			
			flag=1;
		}
		if(flag==1)			   //振动发生flag会置低电平，点亮LED流水灯闪烁
		{
			i=0;
			while(i<9)
			{
				
				P0=table[i]; 
				delay(300);			
				i++;
			}	   
		}
		if(key1==0)				   //按下key1会关掉蜂鸣器的鸣叫和灯光闪烁
		{
			while(!key1);
			flag=0;					//振动标志位置0
			P0=0x00;				//把流水灯端口置0
		}
	}
}

/****************************************************
定时器0的中断服务程序
****************************************************/
void timer0() interrupt 1 
{
	if(flag)
	{
		beep=~beep;		   //中断服务程序使得beep翻转产生方波
	}
	else
	{
		beep=0;			  //使beep端口置0,起保护蜂鸣器作用
	}
}