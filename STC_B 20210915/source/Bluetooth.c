/*-----------------------------------------------------------------------------
   * 实 验 名    : WideMouth 51单片机字符串收发
   * 实验说明  : 单片机串口收发数据控制灯亮灭
   * 实验模块  : STC89C52RC单片机最小系统、HC-06蓝牙模块
   * 连接方式  ：蓝牙模块RXD、TXD端分别连接单片机TXD、RXD端，蓝牙正负极连接单片机正负极
   * 注    意  : 单片机晶振使用的是11.0592
  *******************************************************************************/
#include <STC15F2K60S2.h>
// #include <reg52.h>
#include <string.h> //字符串处理函数包
// #include <intrins.h>
#define uchar unsigned char // 宏定义  51单片机内存资源有限
#define uint unsigned int   //需考虑内存资源问题，故使用无符号类型
uchar receive_data[8];
uint bytes = 0;
uint bytes_old;
//--定义使用的IO--//
sbit Led301 = P2 ^ 0;
sbit Led302 = P2 ^ 3;
//--声明全局函数--//
void uart_init();
void Delay_1ms(uint i);
void SendChar(uchar character);
void SendString(uchar *p);
/********************************************************************
 * 名称 : Com_Int()
 * 功能 : 串口中断函数（接受和发送数据时都会调回此函数）
***********************************************************************/
void Com_Int(void) interrupt
{
    EA = 0;
    if (RI == 1) //此句判断不能省略，否则发送数据时也会执行此语句，造成字符串错误！！！（RI为接收数据标志，当接收到数据自动置为1）
    {
        RI = 0;
        receive_data[bytes] = SBUF; //接收到的数据
        bytes++;
    }
    EA = 1;
}
/*******************************************************************************
  * 函 数 名      : main
  * 函数功能      : 主函数（程序入口）
*******************************************************************************/
void main()
{
    bytes_old = 0;
    uart_init(); //初始化串口
    while (1)
    {
        while (1)
        {
            bytes_old = bytes;
            Delay_1ms(30);          //如果单片机接收来自蓝牙模块不少于1字节的串口数据，一定要加延时后再判断是否，延时时间自己可按情况而定
                                    //接收数据中断一定发生在这30ms内
            if (bytes_old == bytes) //如果在这30ms内无数据接收，说明字符串已接收完毕，这样才能完整的接收一帧串口数据
            {
                receive_data[bytes] = 0; //字符串末尾加结尾标志0（对应/0）
                if (bytes)
                    break; //跳出循环，执行相应逻辑操作
            }
        }
        SendString(receive_data);              //将接收到的完整数据返回给发送端
        if (strcmp(receive_data, "3011") == 0) //strcmp(str1,str2)字符串比较函数.参数 str1 和 str2 是参与比较的两个字符串。
        {                                      //若str1=str2，则返回零；
            Led301 = 0;                        //若str1<str2，则返回负数；
        }                                      //若str1>str2，则返回正数。
        if (strcmp(receive_data, "3010") == 0)
        {
            Led301 = 1;
        }
        if (strcmp(receive_data, "3021") == 0)
        {
            Led302 = 0;
        }
        if (strcmp(receive_data, "3020") == 0)
        {
            Led302 = 1;
        }
        bytes_old = 0; //将bytes_old、bytes置为初始化值，等待接收下一字符串
        bytes = 0;
    }
}
/*******************************************************************************
 * 函 数 名      : uart_init()
 * 函数功能     : 初始化配置串口
 * 备注         ：可直接复制
*******************************************************************************/
void uart_init() //直接复制即可
{
    SCON = 0X50; //设置为工作方式1,8位数据，可变波特率
    TMOD = 0X20; //设置计数器工作方式2
    PCON = 0X00; //波特率不加倍
    TH1 = 0XFd;  //计数器初始值设置，9600@11.0592MHz
    TL1 = 0XFd;
    TR1 = 1; //打开计数器
    ES = 1;  //开串口中断
    EA = 1;  //开总中断
}
/********************************************************************
 * 名称 : Delay_1ms()
 * 功能 : 延时子程序，延时时间为 1ms
 * x * 输入 : x (单位为毫秒)
***********************************************************************/
void Delay_1ms(uint i) //1ms延时，直接复制即可
{
    uint x, j;
    for (j = 0; j < i; j++)
        for (x = 0; x <= 148; x++);
}
/********************************************************************
 * 名称 : SendChar(uchar character)
 * 输入 ：单个字符
 * 功能 : 发送单个字符
***********************************************************************/
void SendChar(uchar character)
{
    SBUF = character; //发送单个字符
    while (!TI);
    TI = 0; //发送完成标志
}
/********************************************************************
 * 名称 : SendString(uchar String[]) 
 * 功能 : 发送字符串
 * 输入 ：字符串
***********************************************************************/
void SendString(uchar String[])
{
    uchar *p = String;
    while (*p) //若指针指向的地址为空，则跳出循环
    {
        SendChar(*p); //指针第一次默认指向首地址
        Delay_1ms(2); //延时，作用为提高发送准确度
        p++;
    }
}